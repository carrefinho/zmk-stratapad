## boards/shields/stratapad-xiao/Kconfig.defconfig
```kconfig
if SHIELD_STRATAPAD_XIAO

config ZMK_KEYBOARD_NAME
    default "Stratapad"
  
endif
```

## boards/shields/stratapad-xiao/Kconfig.shield
```kconfig
config SHIELD_STRATAPAD_XIAO
    def_bool $(shields_list_contains,stratapad_xiao)
```
